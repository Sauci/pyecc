MEMORY
{
    FLASH_ECC_BANK_0_SECTOR_0 (x) : ORIGIN = 0x00000000, LENGTH = 16K
    FLASH_ECC_BANK_0_SECTOR_1 (x) : ORIGIN = 0x00004000, LENGTH = 16K
    FLASH_ECC_BANK_0_SECTOR_2 (x) : ORIGIN = 0x00008000, LENGTH = 16K
    FLASH_ECC_BANK_0_SECTOR_3 (x) : ORIGIN = 0x0000C000, LENGTH = 16K
    FLASH_ECC_BANK_0_SECTOR_4 (x) : ORIGIN = 0x00010000, LENGTH = 16K
    FLASH_ECC_BANK_0_SECTOR_5 (x) : ORIGIN = 0x00014000, LENGTH = 16K
    FLASH_ECC_BANK_0_SECTOR_6 (x) : ORIGIN = 0x00018000, LENGTH = 32K
    FLASH_ECC_BANK_0_SECTOR_7 (x) : ORIGIN = 0x00020000, LENGTH = 128K
    FLASH_ECC_BANK_0_SECTOR_8 (x) : ORIGIN = 0x00040000, LENGTH = 128K
    FLASH_ECC_BANK_0_SECTOR_9 (x) : ORIGIN = 0x00060000, LENGTH = 128K
    FLASH_ECC_BANK_0_SECTOR_10 (x) : ORIGIN = 0x00080000, LENGTH = 256K
    FLASH_ECC_BANK_0_SECTOR_11 (x) : ORIGIN = 0x000C0000, LENGTH = 256K
    FLASH_ECC_BANK_0_SECTOR_12 (x) : ORIGIN = 0x00100000, LENGTH = 256K
    FLASH_ECC_BANK_0_SECTOR_13 (x) : ORIGIN = 0x00140000, LENGTH = 256K
    FLASH_ECC_BANK_0_SECTOR_14 (x) : ORIGIN = 0x00180000, LENGTH = 256K
    FLASH_ECC_BANK_0_SECTOR_15 (x) : ORIGIN = 0x001C0000, LENGTH = 256K
}

ENTRY(int_vector)

SECTIONS
{
    .flash_int_vector 0x00000000 :
    {
        __LD_BOOTLOADER_CHECKSUM_START = .;
        KEEP(*(.flash_int_vector))
        __LD_BOOTLOADER_START = .;
        *(.flash_bootloader)
        . = ALIGN(0x08);
        . = ABSOLUTE(16K - 0x08);
        QUAD(0x636865636B73756D);
        . = ABSOLUTE(16K);
        __LD_BOOTLOADER_CHECKSUM_END = .;
        __LD_BOOTLOADER_CRC = .;
    } > FLASH_ECC_BANK_0_SECTOR_0
}
